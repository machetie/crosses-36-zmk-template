## config/west.yml
```yaml
manifest:
  remotes:
    - name: cormoran
      url-base: https://github.com/cormoran
    - name: zmkfirmware
      url-base: https://github.com/zmkfirmware
    - name: machetie
      url-base: https://github.com/machetie
  projects:
    - name: zmk
      remote: cormoran
      revision: main+dya
      import: app/west.yml
    - name: zmk-driver-pmw3610-with-custom-studio-rpc
      remote: cormoran
      revision: main
    - name: zmk-module-ble-management
      remote: cormoran
      revision: main
    - name: zmk-module-battery-history
      remote: cormoran
      revision: main
    - name: zmk-module-settings-rpc
      remote: cormoran
      revision: main
    - name: zmk-feature-custom-settings
      remote: cormoran
      revision: main
    - name: zmk-module-runtime-input-processor
      remote: cormoran
      revision: main
    - name: zmk-behavior-runtime-sensor-rotate
      remote: cormoran
      revision: main
    - name: zmk-dongle-screen
      remote: machetie
      revision: 02c78a7dadedbe0a83397b2042b7526ab944c1d6
    - name: zmk-report-rate-limit
      remote: machetie
      revision: 06ba1e5d14bf4821d12d7cb101bbef86e46804c3
  self:
    path: config
```
